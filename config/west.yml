## config/west.yml
```yaml
manifest:
  remotes:
    - name: zmkfirmware
      url-base: https://github.com/zmkfirmware
    - name: krikun98
      url-base: https://github.com/krikun98
    - name: jazb
      url-base: https://github.com/jazb
  projects:
    - name: zmk
      remote: jazb
      revision: local-dev 
      import: app/west.yml
  self:
    path: config
```
